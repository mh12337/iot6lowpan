/dts-v1/;

/ {
        compatible = "brcm,bcm2835";

        fragment@0 {
                target = <0xffffffff>;

                __overlay__ {
                        #address-cells = <0x01>;
                        #size-cells = <0x00>;
                        status = "okay";

                        at86rf233@0 {
                                compatible = "atmel,at86rf233";
                                reg = <0x00>;
                                interrupt-parent = <0xffffffff>;
                                interrupts = <0x17 0x04>;
                                reset-gpio = <0xffffffff 0x18 0x01>;
                                sleep-gpio = <0xffffffff 0x19 0x00>;
                                spi-max-frequency = <0x2dc6c0>;
                                xtal-trim = [0f];
                                phandle = <0x01>;
                        };
                };
        };

        fragment@1 {
                target = <0xffffffff>;

                __overlay__ {
                        status = "disabled";
                };
        };

        fragment@2 {
                target = <0xffffffff>;

                __overlay__ {

                        lowpan0_pins {
                                brcm,pins = <0x17 0x18 0x19>;
                                brcm,function = <0x00 0x01 0x01>;
                                phandle = <0x02>;
                        };
                };
        };

        __overrides__ {
                interrupt = [00 00 00 01 69 6e 74 65 72 72 75 70 74 73 3a 30 00 00 00 00 02 62 72 63 6d 2c 70 69 6e 73 3a 30 00];
                reset = [00 00 00 01 72 65 73 65 74 2d 67 70 69 6f 3a 34 00 00 00 00 02 62 72 63 6d 2c 70 69 6e 73 3a 34 00];
                sleep = [00 00 00 01 73 6c 65 65 70 2d 67 70 69 6f 3a 34 00 00 00 00 02 62 72 63 6d 2c 70 69 6e 73 3a 38 00];
                speed = <0x01 0x7370692d 0x6d61782d 0x66726571 0x75656e63 0x793a3000>;
                trim = <0x01 0x7874616c 0x2d747269 0x6d2e3000>;
        };

        __symbols__ {
                lowpan0 = "/fragment@0/__overlay__/at86rf233@0";
                lowpan0_pins = "/fragment@2/__overlay__/lowpan0_pins";
        };

        __fixups__ {
                spi0 = "/fragment@0:target:0";
                gpio = "/fragment@0/__overlay__/at86rf233@0:interrupt-parent:0", "/fragment@0/__overlay__/at86rf233@0:reset-gpio:0", "/fragment@0/__overlay__/at86rf233@0:sleep-gpio:0", "/fragment@2:target:0";
                spidev0 = "/fragment@1:target:0";
        };

        __local_fixups__ {

                __overrides__ {
                        interrupt = <0x00 0x11>;
                        reset = <0x00 0x11>;
                        sleep = <0x00 0x11>;
                        speed = <0x00>;
                        trim = <0x00>;
                };
        };
};